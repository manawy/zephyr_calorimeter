## boards/waveshare/wv_rp2350_pizero/Kconfig.defconfig
```kconfig
# Copyright (c) 2024 Andrew Featherstone
# SPDX-License-Identifier: Apache-2.0

if BOARD_WV_RPI2350_PIZERO

config USB_SELF_POWERED
	default n



if I2C_DW

config I2C_DW_CLOCK_SPEED
	default 150

endif # I2C_DW

endif # BOARD_WV_RPI2350_PIZERO
#
```

## boards/waveshare/wv_rp2350_pizero/board.yml
```yaml
board:
  name: wv_rp2350_pizero
  full_name: Waveshare RP2350 PiZero
  vendor: Waveshare
  socs:
    - name: rp2350b
```
